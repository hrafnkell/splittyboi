## boards/shields/Splittyboi/Kconfig.shield
```kconfig
# No whitespace after the comma or in your part name!
config SHIELD_SPLITTYBOI
    def_bool $(shields_list_contains,Splittyboi)
```

## boards/shields/splittyboi/Kconfig.shield
```kconfig
# No whitespace after the comma or in your part name!
config SHIELD_SPLITTYBOI_LEFT
    def_bool $(shields_list_contains,splittyboi_left)

# No whitespace after the comma or in your part name!
config SHIELD_SPLITTYBOI_RIGHT
    def_bool $(shields_list_contains,splittyboi_right)
```
